## drivers/gpu/arm/t72x/r5p0/Kconfig
```kconfig
#
# (C) COPYRIGHT 2012-2013 ARM Limited. All rights reserved.
#
# This program is free software and is provided to you under the terms of the
# GNU General Public License version 2 as published by the Free Software
# Foundation, and any use by you of this program is subject to the terms
# of such GNU licence.
#
# A copy of the licence is included with the program, and can also be obtained
# from Free Software Foundation, Inc., 51 Franklin Street, Fifth Floor,
# Boston, MA  02110-1301, USA.
#
#


config MALI_GATOR_SUPPORT
	bool "Streamline Debug support"
	depends on MALI_T72X
	default n
	help
	  Adds diagnostic support for use with the ARM Streamline Performance Analyzer.
	  You will need the Gator device driver already loaded before loading this driver when enabling
	  Streamline debug support.

config MALI_DVFS
	bool "Enable DVFS"
	depends on MALI_T72X
	default n
	help
	  Choose this option to enable DVFS on MALI T7xx DDK.

config MALI_RT_PM
	bool "Enable Runtime power management"
	depends on MALI_T72X
	depends on PM_RUNTIME
	default n
	help
	  Choose this option to enable runtime power management on MALI T7xx DDK.

menuconfig MALI_ENABLE_TRACE
	bool "Enable kbase tracing"
	depends on MALI_T72X
	default n
	help
	  Enables tracing in kbase.  Trace log available through
	  the "mali_trace" debugfs file, when the CONFIG_DEBUG_FS is enabled

config MALI_EXYNOS_TRACE
	bool "Enable LSI trace"
	depends on MALI_T72X && MALI_ENABLE_TRACE
#	default y
	help
	  Enable tracing in kbase. It defined by S.LSI

config MALI_FULL_TRACE
	bool "Enable FULL trace"
	depends on MALI_T72X && MALI_ENABLE_TRACE
#	default n
	help
	  Enable tracing in kbase. It defined by ARM and work fully.

config MALI_DEBUG_SYS
	bool "Enable sysfs for mali T72x"
	depends on MALI_T72X && SYSFS
	default n
	help
	  Enables sysfs for mali T72x device. Set/Monitor Mali T72x Device

# MALI_EXPERT configuration options

menuconfig MALI_EXPERT
	depends on MALI_T72X
	bool "Enable Expert Settings"
	default n
	help
	  Enabling this option and modifying the default settings may produce a driver with performance or
	  other limitations.

config MALI_DEBUG_SHADER_SPLIT_FS
	bool "Allow mapping of shader cores via sysfs"
	depends on MALI_T72X && MALI_DEBUG_SYS && MALI_EXPERT
	default n
	help
	  Select this option to provide a sysfs entry for runtime configuration of shader
	  core affinity masks.

config MALI_PLATFORM_FAKE
	bool "Enable fake platform device support"
	depends on MALI_T72X && MALI_EXPERT
	default n
	help
	  When you start to work with the Mali Midgard series device driver the platform-specific code of
	  the Linux kernel for your platform may not be complete. In this situation the kernel device driver
	  supports creating the platform device outside of the Linux platform-specific code.
	  Enable this option if would like to use a platform device configuration from within the device driver.

choice
	prompt "Platform configuration"
	depends on MALI_T72X && MALI_EXPERT
	default MALI_PLATFORM_VEXPRESS
	help
	  Select the SOC platform that contains a Mali Midgard GPU

config MALI_PLATFORM_VEXPRESS_T72X
	depends on ARCH_VEXPRESS && (ARCH_VEXPRESS_CA9X4 || ARCH_VEXPRESS_CA15X4)
	bool "Versatile Express"
config MALI_PLATFORM_VEXPRESS_VIRTEX7_40MHZ_T72X
	depends on ARCH_VEXPRESS && (ARCH_VEXPRESS_CA9X4 || ARCH_VEXPRESS_CA15X4)
	bool "Versatile Express w/Virtex7 @ 40Mhz"
config MALI_PLATFORM_GOLDFISH_T72X
	depends on ARCH_GOLDFISH
	bool "Android Goldfish virtual CPU"
config MALI_PLATFORM_PBX_T72X
	depends on ARCH_REALVIEW && REALVIEW_EB_A9MP && MACH_REALVIEW_PBX
	bool "Realview PBX-A9"
endchoice

config MALI_PLATFORM_THIRDPARTY
    depends on MALI_T72X && MALI_EXPERT
    bool "Third Party Platform"
    default y
      help
      Select the SOC platform that contains a Mali-T72X

config MALI_PLATFORM_THIRDPARTY_NAME
	depends on MALI_T72X && MALI_PLATFORM_THIRDPARTY && MALI_EXPERT
	string "Third party platform name"
	help
	  Enter the name of a third party platform that is supported. The third part configuration
	  file must be in midgard/config/tpip/mali_kbase_config_xxx.c where xxx is the name
	  specified here.

config MALI_DEBUG
	bool "Debug build"
	depends on MALI_T72X && MALI_EXPERT
	default n
	help
	  Select this option for increased checking and reporting of errors.

config MALI_NO_MALI
	bool "No Mali"
	depends on MALI_T72X && MALI_EXPERT
	default n
	help
	  This can be used to test the driver in a simulated environment
	  whereby the hardware is not physically present. If the hardware is physically
	  present it will not be used. This can be used to test the majority of the
	  driver without needing actual hardware or for software benchmarking.
	  All calls to the simulated hardware will complete immediately as if the hardware
	  completed the task.

config MALI_ERROR_INJECT
	bool "Error injection"
	depends on MALI_T72X && MALI_EXPERT && MALI_NO_MALI
	default n
	help
	  Enables insertion of errors to test module failure and recovery mechanisms.

config MALI_TRACE_TIMELINE
	bool "Timeline tracing"
	depends on MALI_T72X && MALI_EXPERT
	default n
	help
	  Enables timeline tracing through the kernel tracepoint system.

config MALI_SYSTEM_TRACE
	bool "Enable system event tracing support"
	depends on MALI_T72X && MALI_EXPERT
	default n
	help
	  Choose this option to enable system trace events for each
	  kbase event.	This is typically used for debugging but has
	  minimal overhead when not in use. Enable only if you know what
	  you are doing.

config MALI_GPU_TRACEPOINTS
	bool "Enable GPU tracepoints"
	depends on MALI_T72X && ANDROID
	select GPU_TRACEPOINTS
	help
	  Enables GPU tracepoints using Android trace event definitions.

config MALI_SEPERATED_UTILIZATION
	bool "Use seperated utilization"
	depends on MALI_T72X
	default y
	help
	  Use seperated utilization from Active/Idle.

config MALI_SEC_HWCNT
	bool "Enable sec hwcnt feature"
	depends on MALI_T72X && MALI_SEPERATED_UTILIZATION
	default y
	help
	  Enable sec hwcnt feature.

source "drivers/gpu/arm/t72x/r5p0/platform/Kconfig"
```

## drivers/gpu/arm/t7xx/Kconfig
```kconfig
#
# (C) COPYRIGHT 2012-2013 ARM Limited. All rights reserved.
#
# This program is free software and is provided to you under the terms of the
# GNU General Public License version 2 as published by the Free Software
# Foundation, and any use by you of this program is subject to the terms
# of such GNU licence.
#
# A copy of the licence is included with the program, and can also be obtained
# from Free Software Foundation, Inc., 51 Franklin Street, Fifth Floor,
# Boston, MA  02110-1301, USA.
#
#


menuconfig MALI_T7XX
	tristate "Mali-T7XX support"
	default n
	help
	  Enable this option to build support for the ARM Mali-T7xx GPU.

	  To compile this driver as a module, choose M here:
	  this will generate a single module, called mali_kbase.

choice
	prompt "version Configuration"
	depends on MALI_T7XX
	default MALI_R5P0
	help
	  Select the gpu support version.

config MALI_R5P0
	depends on MALI_T7XX
	bool "r5p0 driver"

if MALI_R5P0
source "drivers/gpu/arm/t7xx/r5p0/Kconfig"
endif

endchoice
```

## drivers/gpu/ion/Kconfig
```kconfig
menuconfig ION
	tristate "Ion Memory Manager"
	depends on ARM
	select GENERIC_ALLOCATOR
	select DMA_SHARED_BUFFER
	help
	  Chose this option to enable the ION Memory Manager.

config ION_TEGRA
	tristate "Ion for Tegra"
	depends on ARCH_TEGRA && ION
	help
	  Choose this option if you wish to use ion on an nVidia Tegra.

config ION_EXYNOS
	tristate "Ion for Exynos"
	depends on ARCH_EXYNOS && ION
	select CMA
	help
	  Choose this option if you wish to use ion on a Samsung Exynos.

config ION_EXYNOS_STAT_LOG
	bool "Gathering stats for Exynos ION"
	default y
	depends on ION_EXYNOS && DEBUG_FS
	help
	  Say Y if you need to see some stats info via debugfs

if ION_EXYNOS
source drivers/gpu/ion/exynos/Kconfig
endif
```

## drivers/gud/Kconfig
```kconfig
#
# Mobicore Configuration
#

if SOC_EXYNOS5422
source "drivers/gud/gud-exynos5422/Kconfig"
endif

if SOC_EXYNOS5430
source "drivers/gud/gud-exynos5430/Kconfig"
endif

if SOC_EXYNOS5433
source "drivers/gud/gud-exynos5433/Kconfig"
endif

if SOC_EXYNOS7420
source "drivers/gud/gud-exynos7420/Kconfig"
endif

source "drivers/gud/TlcTui/Kconfig"
```

## drivers/gud/gud-exynos5433/sec-os-booster/Kconfig
```kconfig
#
# Secure OS control configuration
#
config SECURE_OS_BOOSTER_API
	bool "Secure OS booster API"
	depends on MOBICORE_DRIVER
	---help---
	  The secure OS booster API is used for secure OS performance
	  enhancement. It can migrate a core that executes secure OS tasks
	  and lock CPU frequency.
```

## drivers/input/misc/fpc-fingerprint/Kconfig
```kconfig
menuconfig INPUT_FPC_FINGERPRINT
	bool "fpc fingerprint module"
	default y
	help
	  Say Y here, and a list of fpc fingerprint input drivers will be displayed.

if INPUT_FPC_FINGERPRINT

config INPUT_FPC1020_FINGERPRINT 
	tristate "FPC fingerprint sensor support"
	default y
	depends on SPI_MASTER

endif
```

## drivers/input/touchscreen/stm/Kconfig
```kconfig
#
# STMicroelectronics TOUCH driver configuration
#

config TOUCHSCREEN_FTS
	tristate "STMicroelectronics i2c multitouch touchscreen with FingerTipS"
	depends on I2C
	help
		Say Y here to enable STMicroelectronics touchscreen support.
		If unsure, say N.
		To compile this driver as a module, choose M here: the
		module will be called STM_ts.

config KEY_LED_POWER_DISABLE
	bool "KEY LED POWER DISABLE"
	help
		Say Y if you want to disable LED key button.
		Usually you might want to set it N.
```

## drivers/media/platform/exynos/Kconfig
```kconfig
#
# Exynos multimedia device drivers
#
config VIDEO_EXYNOS
	bool "Exynos Multimedia Devices"
	depends on ARCH_EXYNOS4 || ARCH_EXYNOS5 || ARCH_EXYNOS7
	default y
	help
	  This is a representative exynos multimedia device.

if VIDEO_EXYNOS
	source "drivers/media/platform/exynos/mdev/Kconfig"
	source "drivers/media/platform/exynos/gsc_1.3/Kconfig"
	source "drivers/media/platform/exynos/gsc/Kconfig"
	source "drivers/media/platform/exynos/mfc/Kconfig"
	source "drivers/media/platform/exynos/hevc/Kconfig"
if SOC_EXYNOS7420
	source "drivers/media/platform/exynos/fimc-is2/Kconfig"
endif
if !SOC_EXYNOS7420
	source "drivers/media/platform/exynos/fimc-is/Kconfig"
endif
	source "drivers/media/platform/exynos/scaler/Kconfig"
	source "drivers/media/platform/exynos/fimg2d/Kconfig"
	source "drivers/media/platform/exynos/jpeg4/Kconfig"
	source "drivers/media/platform/exynos/jpeg_hx/Kconfig"
	source "drivers/media/platform/exynos/tv/Kconfig"
	source "drivers/media/platform/exynos/jpeg/Kconfig"
endif

config MEDIA_EXYNOS
	bool
	help
	  Compile mdev to use exynos5 media device driver.
```

## drivers/media/platform/exynos/fimc-is/Kconfig
```kconfig
config VIDEO_EXYNOS_FIMC_IS
	bool "Exynos FIMC-IS (Image Subsystem) driver"
	depends on VIDEO_EXYNOS
	select MEDIA_EXYNOS
	select USE_VENDER_FEATURE if SEC_DEBUG
	default n
	help
	  This is a v4l2 driver for exynos FIMC-IS device.
config CAMERA_EEPROM_SUPPORT
        bool "Enable to eeprom"
        depends on VIDEO_EXYNOS_FIMC_IS
        default n
        help
          Enable to eeprom.
config COMPANION_USE
        bool "Enable to companion"
        depends on VIDEO_EXYNOS_FIMC_IS
        default n
        help
          Enable to companion.
config OIS_USE
        bool "Enable to ois"
        depends on VIDEO_EXYNOS_FIMC_IS
        default n
        help
          Enable to ois.
config OIS_FW_UPDATE_THREAD_USE
        bool "Enable to ois fw update thread"
        depends on OIS_USE
        default n
        help
          Enable to ois fw update thread.
config AF_HOST_CONTROL
        bool "Enable to af control"
        depends on VIDEO_EXYNOS_FIMC_IS
        default n
        help
          Enable to af control.
config USE_VENDER_FEATURE
	bool "Use vendor specific features"
        depends on VIDEO_EXYNOS_FIMC_IS
	default n
	help
          Enable to use the vender.
config CAMERA_SENSOR_8B1
        bool "Use 8B1 camera sensor"
        depends on VIDEO_EXYNOS_FIMC_IS
        default n
        help
          Use 8B1 camera sensor.
config CAMERA_SENSOR_6D1
        bool "Use 6D1 camera sensor"
        depends on VIDEO_EXYNOS_FIMC_IS
        default n
        help
          Use 6D1 camera sensor.
```

## drivers/media/platform/exynos/fimc-is2/Kconfig
```kconfig
config VIDEO_EXYNOS_FIMC_IS
	bool "Exynos FIMC-IS2 (Image Subsystem) driver"
	depends on VIDEO_EXYNOS
	select MEDIA_EXYNOS
	select USE_VENDER_FEATURE if SEC_DEBUG
	default n
	help
	  This is a v4l2 driver for exynos FIMC-IS device.
config USE_VENDER_FEATURE
	bool "Use vendor specific features"
        depends on VIDEO_EXYNOS_FIMC_IS
	default n
	help
          Use the vender specfic features.

config ENABLE_HAL3_2_META_INTERFACE
	bool "Use HAL 3_2 Meta interface"
        depends on VIDEO_EXYNOS_FIMC_IS
	default n
	help
          Use the unified meta in 3.2 and 1.0 HAL.

config CAMERA_SUPPORT_PDAF
	bool "Open PDAF Device with FIMC LITE"
	depends on VIDEO_EXYNOS_FIMC_IS
	default n
	help
	  Open PDAF Device with FIMC LITE.

config CAMERA_EEPROM_SUPPORT
	bool "Enable to eeprom"
	depends on VIDEO_EXYNOS_FIMC_IS
	default y
	help
	  Enable to eeprom.

config CAMERA_EEPROM_SUPPORT_REAR
	bool "Enable to rear eeprom"
	depends on VIDEO_EXYNOS_FIMC_IS
	default y
	help
	  Enable to rear eeprom.

config CAMERA_CUSTOM_SUPPORT
	bool "Support CUSTOM usecase"
	depends on VIDEO_EXYNOS_FIMC_IS
	default y
	help
	  Enable to use customer usecase.

config MEIZU_CAMERA_SPECIAL
    bool "Meizu camera special feature"
	depends on VIDEO_EXYNOS_FIMC_IS
    default n
    help
     Enable to make use of meizu camera special feature.

source "drivers/media/platform/exynos/fimc-is2/sensor/Kconfig"
source "drivers/media/platform/exynos/fimc-is2/ischain/Kconfig"
source "drivers/media/platform/exynos/fimc-is2/ois/Kconfig"
```

## drivers/media/platform/exynos/fimc-is2/ois/Kconfig
```kconfig
config MZ_ROHM_OIS
    bool "Meizu Rhom's OIS driver"
    default n
    help
      This is MEIZU M86 RHOM's BU63165 OIS driver.
```

## drivers/media/platform/exynos/fimc-is2/sensor/Kconfig
```kconfig
source "drivers/media/platform/exynos/fimc-is2/sensor/module/Kconfig"
source "drivers/media/platform/exynos/fimc-is2/sensor/csi/Kconfig"
```

## drivers/media/platform/exynos/fimc-is2/sensor/csi/Kconfig
```kconfig
config CSI_V3_2
	bool "Use csi v3.2"
	depends on VIDEO_EXYNOS_FIMC_IS
	default n
	help
	  csi version 3.2

config CSI_V3_4
	bool "Use csi v3.4"
	depends on VIDEO_EXYNOS_FIMC_IS
	default n
	help
	  csi version 3.4
```
