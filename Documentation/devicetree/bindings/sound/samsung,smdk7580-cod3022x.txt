## Documentation/devicetree/bindings/sound/samsung,smdk7580-cod3022x.txt
```
Samsung SMDK7580 audio complex

Required properties:
- compatible : "samsung,smdk7580-cod3022x"
- samsung,audio-cpu: The phandle of the Samsung I2S0 controller
- samsung,audio-codec: The phandle of the Codec node
- samsung,auxdev: The phandle of auxdev node

Example:

sound {
	compatible = "samsung,smdk7580-cod3022x";
	samsung,audio-cpu = <&i2s0	/* primary */
				&i2s0	/* secondary */
				&audio_cp_dummy
				&audio_bt_dummy>;
	samsung,audio-codec = <&audio_codec_cod3022x
				&audio_codec_cod3022x
				&audio_codec_dummy
				&audio_codec_dummy>;
	samsung,auxdev = <&s2801x>;
	status = "okay";
};
```

## arch/arm64/Kconfig.debug
```kconfig
menu "Kernel hacking"

source "lib/Kconfig.debug"

config FRAME_POINTER
	bool
	default y

config DEBUG_STACK_USAGE
	bool "Enable stack utilization instrumentation"
	depends on DEBUG_KERNEL
	help
	  Enables the display of the minimum amount of free stack which each
	  task has ever had available in the sysrq-T output.

config ARM64_PTDUMP
	bool "Export kernel pagetable layout to userspace via debugfs"
	depends on DEBUG_KERNEL
	select DEBUG_FS
        help
	  Say Y here if you want to show the kernel pagetable layout in a
	  debugfs file. This information is only useful for kernel developers
	  who are working in architecture specific areas of the kernel.
	  It is probably not a good idea to enable this feature in a production
	  kernel.
	  If in doubt, say "N"

config STRICT_DEVMEM
	bool "Filter access to /dev/mem"
	depends on MMU
	help
	  If this option is disabled, you allow userspace (root) access to all
	  of memory, including kernel and userspace memory. Accidental
	  access to this is obviously disastrous, but specific access can
	  be used by people debugging the kernel.

	  If this option is switched on, the /dev/mem file only allows
	  userspace access to memory mapped peripherals.

	  If in doubt, say Y.

config EARLY_PRINTK
	bool "Early printk support"
	default y
	help
	  Say Y here if you want to have an early console using the
	  earlyprintk=<name>[,<addr>][,<options>] kernel parameter. It
	  is assumed that the early console device has been initialised
	  by the boot loader prior to starting the Linux kernel.

config PID_IN_CONTEXTIDR
	bool "Write the current PID to the CONTEXTIDR register"
	help
	  Enabling this option causes the kernel to write the current PID to
	  the CONTEXTIDR register, at the expense of some additional
	  instructions during context switch. Say Y here only if you are
	  planning to use hardware trace tools with this kernel.

config DEBUG_RODATA
	bool "Make kernel text and rodata read-only"
	help
	  If this is set, kernel text and rodata will be made read-only. This
	  is to help catch accidental or malicious attempts to change the
	  kernel's executable code. Additionally splits rodata from kernel
	  text so it can be made explicitly non-executable.

          If in doubt, say Y

endmenu
```

## arch/arm64/mach-exynos/Kconfig
```kconfig
# arch/arm/mach-exynos/Kconfig
#
# Copyright (c) 2010-2011 Samsung Electronics Co., Ltd.
#		http://www.samsung.com/
#
# Licensed under GPLv2

# Configuration options for the EXYNOS4

if ARCH_EXYNOS

menu "SAMSUNG EXYNOS SoCs Support"

config ARCH_EXYNOS5
	bool "SAMSUNG EXYNOS5"
	select HAVE_ARM_SCU if SMP
	select HAVE_SMP
	select HAVE_EXYNOS5_HSI2C if I2C
	help
	  Samsung EXYNOS5 (Cortex-A53/A57) SoC based systems

config ARCH_EXYNOS7
	bool "SAMSUNG EXYNOS7"
	select HAVE_ARM_SCU if SMP
	select HAVE_SMP
	select HAVE_EXYNOS5_HSI2C if I2C
	select PM_GENERIC_DOMAINS if PM
	help
	  Samsung EXYNOS7 (Cortex-A57/A53) SoC based systems

config SOC_EXYNOS7420
	bool "SAMSUNG EXYNOS7420"
	depends on ARCH_EXYNOS7
	select SAMSUNG_DMADEV
	select CAL_SYS_PWRDOWN
	select EXYNOS_SPI_RESET_DURING_DSTOP if CPU_IDLE
	help
	  Enable EXYNOS7420 SoC support

config SOC_EXYNOS7420_EVT_0
	bool "SAMSUNG EXYNOS7420 EVT0"
	depends on SOC_EXYNOS7420
	select CAL_SYS_PWRDOWN
	help
	  Enable EXYNOS7420 EVT0 SoC support

config SOC_EXYNOS7580
	bool "SAMSUNG EXYNOS7580"
	depends on ARCH_EXYNOS7
	select SAMSUNG_DMADEV
	select CAL_SYS_PWRDOWN
	select ARCH_HAS_OPP
	select ARCH_HAS_BANDGAP
	help
	  Enable EXYNOS7580 SoC support

config SOC_EXYNOS5433
	bool "SAMSUNG EXYNOS5433"
	default n
	depends on ARCH_EXYNOS5
	select PM_GENERIC_DOMAINS if PM
	select S5P_PM if PM
	select S5P_SLEEP if SUSPEND
	select SAMSUNG_DMADEV
	select EXYNOS_HSI2C_RESET_DURING_DSTOP if CPU_IDLE
	select EXYNOS_SPI_RESET_DURING_DSTOP if CPU_IDLE
	select CAL_SYS_PWRDOWN
	help
	  Enable EXYNOS5433 SoC support

config EXYNOS_ASV
	bool "ENABLE EXYNOS ASV"
	default n
	depends on ARCH_EXYNOS

config EXYNOS_ASV_DYNAMIC_ABB
	bool "Enable Dynamic ABB"
	default n
	depends on EXYNOS_ASV

config EXYNOS_ASV_SUPPORT_RCC
	bool "Support RCC Table"
	default n
	depends on EXYNOS_ASV

config EXYNOS_ASV_MARGIN_TEST
	bool "Enable Margin Test"
	default n
	depends on EXYNOS_ASV

config CAL_SYS_PWRDOWN
	bool "Enable CAL for system level power down"

config EXYNOS_ATAGS
	def_bool "ATAGS based boot for EXYNOS (deprecated)"
	depends on !ARCH_MULTIPLATFORM
	depends on ATAGS
	help
	  The EXYNOS platform is moving towards being completely probed
	  through device tree. This enables support for board files using
	  the traditional ATAGS boot format.
	  Note that this option is not available for multiplatform builds.

config EXYNOS5_DYNAMIC_CPU_HOTPLUG
	bool "Dynamic CPU Hotplug support"
	depends on !SOC_EXYNOS7580
	depends on CPU_FREQ
	help
		Enable Dynamic CPU Hotplug
		
config EXYNOS_MARCH_DYNAMIC_CPU_HOTPLUG
	bool "March Dynamic CPU Hotplug support"
	depends on !SOC_EXYNOS7580
	depends on CPU_FREQ
	help
		Enable March Dynamic CPU Hotplug

config EXYNOS_CPU_CORE_NUM_PM_QOS
	bool "Control CPU Core number"
	depends on !SOC_EXYNOS7580
	default y
	help
		Enable March Dynamic CPU Hotplug
		
config APRIL_DYNAMIC_CPU_HOTPLUG_SCHEME
	bool "New Hotpllug scheme for Test in April"
	default n
	help
	  New Hotplug scheme with cpu num qos

menu "Extensions for Dynamic CPU Hotplug support"
depends on EXYNOS5_DYNAMIC_CPU_HOTPLUG
config DEFERRABLE_DM_HOTPLUG
        bool "Deferrable Hotplug Invoking"
        help
          Dynamic CPU Hotplug is invoked deferrable-periodically

          If in doubt, say N.
endmenu


config EXYNOS7580_DYNAMIC_CLUSTER_HOTPLUG
	bool "Dynamic CLUSTER Hotplug support"
	depends on SOC_EXYNOS7580
	depends on CPU_FREQ
	help
		Enable Dynamic CLUSTER Hotplug

config EXYNOS_CONTENT_PATH_PROTECTION
	bool "Exynos Content Path Protection"
	depends on ARM_TRUSTZONE
	default n
	help
	  Enable content path protection of EXYNOS.

config EXYNOS5_SETUP_MIPIPHY
	bool
	depends on (VIDEO_EXYNOS_FIMC_IS || DECON_MIPI_DSI || EXYNOS_MIPI_DSI)
	default y
	help
	  Compile in common setup code for MIPI-CSIS devices

config RESET_REASON_EXYNOS7420
	bool "Exynos7420 reset reason support"
	help
	  Exynos7420 hw and sw reset reasons record.

if EXYNOS_ATAGS

config EXYNOS_DEV_DMA
	bool
	help
	  Compile in amba device definitions for DMA controller

config EXYNOS4_DEV_AHCI
	bool
	help
	  Compile in platform device definitions for AHCI

config EXYNOS4_SETUP_FIMD0
	bool
	help
	  Common setup code for FIMD0.

config EXYNOS4_DEV_USB_OHCI
	bool
	help
	  Compile in platform device definition for USB OHCI

config EXYNOS4_SETUP_I2C1
	bool
	help
	  Common setup code for i2c bus 1.

config EXYNOS4_SETUP_I2C2
	bool
	help
	  Common setup code for i2c bus 2.

config EXYNOS4_SETUP_I2C3
	bool
	help
	  Common setup code for i2c bus 3.

config EXYNOS4_SETUP_I2C4
	bool
	help
	  Common setup code for i2c bus 4.

config EXYNOS4_SETUP_I2C5
	bool
	help
	  Common setup code for i2c bus 5.

config EXYNOS4_SETUP_I2C6
	bool
	help
	  Common setup code for i2c bus 6.

config EXYNOS4_SETUP_I2C7
	bool
	help
	  Common setup code for i2c bus 7.

config EXYNOS4_SETUP_KEYPAD
	bool
	help
	  Common setup code for keypad.

config EXYNOS4_SETUP_SDHCI
	bool
	select EXYNOS4_SETUP_SDHCI_GPIO
	help
	  Internal helper functions for EXYNOS4 based SDHCI systems.

config EXYNOS4_SETUP_SDHCI_GPIO
	bool
	help
	  Common setup code for SDHCI gpio.

config EXYNOS4_SETUP_FIMC
	bool
	help
	  Common setup code for the camera interfaces.

config EXYNOS4_SETUP_USB_PHY
	bool
	help
	  Common setup code for USB PHY controller

config EXYNOS_SETUP_SPI
	bool
	help
	  Common setup code for SPI GPIO configurations.

endif

comment "Flattened Device Tree based board for EXYNOS SoCs"
config SUPPORT_CODEGEN
	bool "Support Code Generator on EXYNOS device tree platform"
	help
	  Use device tree files matched with code generator tool.

config MACH_ESPRESSO7420
	bool "SAMSUNG ESPRESSO7420 Machine using device tree"
	select ARM_AMBA
	select CLKSRC_OF
	select USE_OF
	select PINCTRL
	select PINCTRL_EXYNOS
	select S3C_DEV_RTC
	select MIGHT_HAVE_PCI
	select PCI_DOMAINS if PCI
	help
	  Machine support for Samsung EXYNOS7420 machine with device tree enabled.
	  Select this if a fdt blob is available for the EXYNOS7420 SoC based board.

config MACH_AVL7420
	bool "SAMSUNG AVL7420 Machine using device tree"
	select ARM_AMBA
	select CLKSRC_OF
	select USE_OF
	select PINCTRL
	select PINCTRL_EXYNOS
	select S3C_DEV_RTC
	select MIGHT_HAVE_PCI
	select PCI_DOMAINS if PCI
	help
	  Machine support for Samsung AVL7420 machine with device tree enabled.
	  Select this if a fdt blob is available for the AVL7420 SoC based board.

config MACH_M86
	bool "MEIZU M86 Machine using device tree"
	select ARM_AMBA
	select CLKSRC_OF
	select USE_OF
	select PINCTRL
	select PINCTRL_EXYNOS
	select S3C_DEV_RTC
	select MIGHT_HAVE_PCI
	select PCI_DOMAINS if PCI
	help
	  Machine support for Meizu M86 machine with device tree enabled.
	  Select this if a fdt blob is available for the M86 based board.

choice
	prompt "Kernel type selection for MEIZU MX"
	depends on MACH_M86

config ENG_KERNEL
	bool "Build Eng Kernel"
	help
		Build Eng kernel

config USER_KERNEL
	bool "Build User Kernel"
	help
		Build User kernel

config UNICOM_KERNEL
	bool "Build Unicom Kernel"
	help
		Build Unicom kernel

config OVERSEAS_KERNEL
	bool "Build Overseas Kernel"
	help
		Build Overseas kernel

config RECOVERY_KERNEL
	bool "Build Recovery Kernel"
	help
		Build Recovery kernel

config CHARGE_KERNEL
	bool "Build Charge Kernel"
	help
		Build Charge kernel

config FACTORY_KERNEL
	bool "Build Factory Kernel"
	help
		Build factory kernel
endchoice

config MACH_SMDK7580
	bool "SAMSUNG SMDK7580 Machine using device tree"
	select ARM_AMBA
	select USE_OF
	select PINCTRL
	select PINCTRL_EXYNOS
	help
	  Machine support for Samsung EXYNOS7580 machine with device tree enabled.
	  Select this if a fdt blob is available for the EXYNOS7580 SoC based board.

endmenu

choice
	prompt "Type of Periodic Devfreq method"
	default DELAYED_INVOKING
	help
		This option sets which type of Workqueue shall be used for periodic execution. 
		Such as, DEVFREQ, MIF DTM, Cluster On/Off Monitoring, PPMU Monitoring, and Main DTM
		
config DELAYED_INVOKING
	bool "Use delayed workqueue"
	help 
		Use the INIT_DELAYED_WORK() for Devfreq
		
config DEFERRABLE_INVOKING
	bool "Use deferrable workqueue"
	help 
		Use the INIT_DEFERRABLE_WORK() for Devfreq

config HYBRID_INVOKING
	bool "Use hybrid workqueue"
	help 
		Use the Hybrid WQ (both DELAYED and DEFERRABLE) for Devfreq

endchoice

# Reset IPs during LPA/DSTOP
config EXYNOS_SPI_RESET_DURING_DSTOP
	bool

endif
```

## backports/Kconfig
```kconfig
config BACKPORT_INTEGRATE
	bool
	def_bool y

config BACKPORT_DIR
	string
	default "backports/"

config BACKPORT_VERSION
	string
	default "v4.2-rc1-1-3-g0d0798b"

config BACKPORT_KERNEL_VERSION
	string
	default "v4.2-rc7-0-g2c6625c"

config BACKPORT_KERNEL_NAME
	string
	default "Linux"

menuconfig BACKPORT_LINUX
	bool "Backport Linux v4.2-rc7-0-g2c6625c (backports v4.2-rc1-1-3-g0d0798b)"
	default n
	---help---
	  Enabling this will let give you the opportunity to use features and
	  drivers backported from Linux v4.2-rc7-0-g2c6625c
	  on the kernel your are using. This is experimental and you should
	  say no unless you'd like to help test things or want to help debug
	  this should we run into any issues.

if BACKPORT_LINUX

config BACKPORT_KERNEL_3_11
    def_bool y
config BACKPORT_KERNEL_3_12
    def_bool y
config BACKPORT_KERNEL_3_13
    def_bool y
config BACKPORT_KERNEL_3_14
    def_bool y
config BACKPORT_KERNEL_3_15
    def_bool y
config BACKPORT_KERNEL_3_16
    def_bool y
config BACKPORT_KERNEL_3_17
    def_bool y
config BACKPORT_KERNEL_3_18
    def_bool y
config BACKPORT_KERNEL_3_19
    def_bool y
config BACKPORT_KERNEL_4_0
    def_bool y
config BACKPORT_KERNEL_4_1
    def_bool y
config BACKPORT_KERNEL_4_2
    def_bool y

# this has the configuration for the backport code
source "$BACKPORT_DIR/compat/Kconfig"

# these are copied from the kernel
source "$BACKPORT_DIR/net/bluetooth/Kconfig"

source "$BACKPORT_DIR/net/6lowpan/Kconfig"
source "$BACKPORT_DIR/net/ieee802154/Kconfig"
source "$BACKPORT_DIR/net/mac802154/Kconfig"

endif # BACKPORT_LINUX
```
