## drivers/misc/mcu_ipc/Kconfig
```kconfig
#
# MCU_IPC Device Driver
#

config MCU_IPC
     bool "MCU IPC Support"
     default n
	 help
	   This enables MCU_IPC driver to control the MCU_IPC Device.

	   MCU_IPC is the Mailbox which has 16 interrupts for TX/RX each
	   and 256 bytes memory for communicating messages.
	   AP and CP can share the messages through this device.
```

## drivers/misc/mipi-lli/Kconfig
```kconfig
#
# MIPI LLI
#

menuconfig MIPI_LLI
	tristate "MIPI LLI"
	default n
	help
	  It is for supporting MIPI LLI driver.

if MIPI_LLI
config MIPI_LLI_BOOT_SPI
	bool "Use SPI booting for modem"
	default n
	help
	  Use SPI booting for modem.

config EXYNOS_MIPI_LLI
	bool "Enable Exynos MIPI LLI"
	default y
	help
	  Enable MIPI LLI via Shared Memory.

config EXYNOS_MIPI_LLI_MPHY
	bool "Enable Exynos MIPI LLI MPHY"
	default y
	depends on EXYNOS_MIPI_LLI
	help
	  Enable M-PHY for MIPI-LLI

endif # MIPI_LLI
```

## drivers/misc/modem_v1/Kconfig
```kconfig
comment "Samsung Mobile Modem Driver (SVNET2) V1 for Memory-type Interface"
menuconfig SEC_MODEM_IF_V1
	bool "Samsung Mobile Modem Interface"
	default n
	---help---
	  Samsung Modem Interface Driver.

config BOOT_DEVICE_SPI
	bool "boot device: SPI"
	depends on SEC_MODEM_IF_V1
	default y

config UMTS_MODEM_SS333
	bool "modem chip : SEC SS333"
	depends on SEC_MODEM_IF_V1
	default y

config LINK_DEVICE_LLI
	bool "modem drvier link device LLI"
	depends on SEC_MODEM_IF_V1
	default y

config LINK_POWER_MANAGEMENT_WITH_FSM
	bool "POWER_MANAGEMENT_WITH_FSM"
	depends on LINK_DEVICE_LLI
	default y

config WORKQUEUE_FRONT
	bool "IPC: SPI workqueue front"
	depends on SEC_MODEM_IF_V1
	default n

config SIM_DETECT
	bool "SIM_DETECT pin"
	depends on SEC_MODEM_IF_V1
	default n

config SIM_SLOT_SWITCH
	bool "SIM_SLOT_SWITCH"
	depends on SEC_MODEM_IF_V1
	default n
```

## drivers/misc/sscr_tools/Kconfig
```kconfig
menu "SSCR_DEBUG_TOOLS"

config SSCR_TOOLS
	bool "Enable sscr_tools"
	help
	  Enable sscr_tools such as timestamp.

config SSCR_SEC_LOG
	bool "Record panic log to files"
	help
	  Panic log will be recorded to on 512K reserved memory.

endmenu
```

## drivers/misc/type-c/Kconfig
```kconfig
menu "TYPE-C support"

config TYPEC_FUSB302
	tristate "FairChild Fusb302 Type-C USB connector"
	depends on I2C && SYSFS
	help
	  Enable this driver to support FUSB302 Type-C connector

endmenu
```

## drivers/muic/Kconfig
```kconfig
#
# MUIC devices
#

comment "MUIC configs"

config USE_MUIC
	bool "Using MUIC device driver"
	depends on I2C
	default n
	help
	  If you say yes here you will get support for
	  the MUIC device driver.

config USE_SAFEOUT
	bool "Using SAFEOUT device driver"
	depends on I2C
	default n
	help
	  If you say yes here you will get support for
	  the SAFEOUT device driver.

config MUIC_NOTIFIER
	bool "MUIC notifier support"
	depends on USE_MUIC
	default n
	help
	  If you say yes here you will get support for
	  the MUIC attached device status change notification.

config SAMSUNG_MUIC
	bool "Using samsung MUIC chip driver"
	depends on USE_MUIC
	default n
	help
	  If you say yes here you will get support for the MUIC chip.

config MUIC_ADCMODE_SWITCH_WA
	bool "Using MUIC chip ADC Mode change W/A"
	depends on USE_MUIC
	default n
	help
	  This feature is for MUIC chip's ADC Mode change
	  chip bug Workaround.

config MUIC_RUSTPROOF_ON_USER
	bool "Using MUIC chip Rustproof function ON for User binary"
	depends on USE_MUIC
	default n
	help
	  This feature is for MUIC chip's Rustproof function.

config MUIC_FSA9480
	tristate "FSA9480 USB Switch"
	depends on I2C
	help
	  The FSA9480 is a USB port accessory detector and switch.
	  The FSA9480 is fully controlled using I2C and enables USB data,
	  stereo and mono audio, video, microphone and UART data to use
	  a common connector port.

config MUIC_MAX77804
	bool "Using MAX77804 MUIC"
	depends on MFD_MAX77804 && USE_MUIC
	default n
	help
	  If you say yes here you will get support for
	  for the MAX77804 MUIC chip.

config MUIC_MAX77804K
	bool "Using MAX77804K MUIC"
	depends on MFD_MAX77804K && USE_MUIC
	default n
	help
	  If you say yes here you will get support for
	  for the MAX77804K MUIC chip.

config MUIC_MAX77828
	bool "Using MAX77828 MUIC"
	depends on MFD_MAX77828 && USE_MUIC
	default n
	help
	  If you say yes here you will get support for
	  for the MAX77828 MUIC chip.

config MUIC_MAX77843
	bool "Using MAX77843 MUIC"
	depends on MFD_MAX77843 && USE_MUIC
	default n
	help
	  If you say yes here you will get support for
	  for the MAX77843 MUIC chip.

config HV_MUIC_MAX77843_AFC
	bool "Using MAX77843 AFC MUIC"
	depends on MUIC_MAX77843
	default n
	help
	  If you say yes here you will get support for the MAX77843 AFC MUIC.

config MUIC_MAX77843_IGNORE_ADCERR_WA
	bool "Using MAX77843 MUIC ignore ADCERR WA"
	depends on MUIC_MAX77843
	default n
	help
	  If you say yes here you will get support for the MAX77843 MUIC RESET WA.

config MUIC_MAX77843_RESET_WA
	bool "Using MAX77843 MUIC RESET WA"
	depends on MUIC_MAX77843
	default n
	help
	  If you say yes here you will get support for the MAX77843 MUIC RESET WA.

config MUIC_MAX77833
        bool "Using MAX77833 MUIC"
        depends on MFD_MAX77833 && USE_MUIC
        default n
        help
          If you say yes here you will get support for 
          for the MAX77833 MUIC chip.

config HV_MUIC_MAX77833_AFC
        bool "Using MAX77833 AFC MUIC"
        depends on MUIC_MAX77833
        default n
        help
          If you say yes here you will get support for the MAX77833 AFC MUIC.

config MUIC_MAX77833_IGNORE_ADCERR_WA
        bool "Using MAX77833 MUIC ignore ADCERR WA"
        depends on MUIC_MAX77833
        default n
        help
          If you say yes here you will get support for the MAX77833 MUIC RESET WA. 

config MUIC_MAX77833_RESET_WA
        bool "Using MAX77833 MUIC RESET WA"
        depends on MUIC_MAX77833
        default n
        help
          If you say yes here you will get support for the MAX77833 MUIC RESET WA.

config MUIC_MAX77888
	bool "Using MAX77888 MUIC"
	depends on MFD_MAX77888 && USE_MUIC
	default n
	help
	  If you say yes here you will get support for
	  for the MAX77888 MUIC chip.

config MUIC_S2MM001
	bool "Using S2MM001 MUIC"
	depends on USE_MUIC
	default n
	help
	  If you say yes here you will get support for
	  for the S2MM001 MUIC chip.
```

## drivers/pci/host/Kconfig
```kconfig
menu "PCI host controller drivers"
	depends on PCI

config PCI_MVEBU
	bool "Marvell EBU PCIe controller"
	depends on ARCH_MVEBU || ARCH_KIRKWOOD

config PCIE_DW
	bool

config PCI_EXYNOS
	bool "Samsung Exynos PCIe controller"
	depends on SOC_EXYNOS5433 || SOC_EXYNOS7420
	select PCIEPORTBUS
	select PCIE_DW

config PCI_EXYNOS_TEST
	bool "EXYNOS PCIe driver test"
	depends on PCI_EXYNOS

config PCI_EXYNOS_REDUCE_RESET_WAIT
	bool "EXYNOS PCIe driver resume reset wait time reduce"
	default n

endmenu
```

## drivers/staging/samsung/Kconfig
```kconfig
# drivers/staging/samsung/Kconfig
#
# Copyright (c) 2010-2011 Samsung Electronics Co., Ltd.
#		http://www.samsung.com/
#
# Licensed under GPLv2

config SEC_EXT
	bool "Samsung TN extension Feature"
	default n

config SEC_REBOOT
	bool "Samsung TM reboot extension Feature"
	default n
	help
	  Samsung TN reboot extension Feature. Do additional work when reboot.

config SEC_MISC
	bool "Samsung TM Misc Feature"
	default n
	help
	  Samsung TN Misc extension Feature. Do additional work when Misc.

config SEC_MEM
	bool "Samsung TM memory information Feature"
	default n
	help
	  Samsung TN memory inforamtion Feature, Get information from proc node.

comment "sec sysfs Feature"
config SEC_SYSFS
	bool "Samsung sec sysfs Feature"
	default y
	depends on SEC_EXT
	help
	  Samsung sysfs name 'sec' directory create.

comment "Debugging Feature"
menuconfig SEC_DEBUG
	bool "Samsung TN Ramdump Feature"
	default y
	depends on SEC_EXT
	help
	  Samsung TN Ramdump Feature. Use INFORM3 and magic number at 0xc0000000.

if SEC_DEBUG
config SEC_DEBUG_FUPLOAD_DUMP_MORE
	bool "Dump more information at forced upload"
	default n
	help
	  More information is printed out when a forced upload happens.
	  It uses customized dump functions instead of panic call.

config SEC_DEBUG_SCHED_LOG
	bool "Samsung Scheduler Logging Feature"
	default n
	help
	  Samsung Scheduler Logging Feature for Debug use.

config SEC_DEBUG_SOFTIRQ_LOG
	bool "Samsung Softirq Logging Feature"
	default n
	depends on SEC_DEBUG_SCHED_LOG
	help
	  Samsung Softirq Logging Feature for Debug use.
	  This option enables us to log softirq enter/exit.
	  It is not only hard-irq which results in scheduler lockup,
	  To be more clear we need to see also softirq logs.

config SEC_DEBUG_SCHED_LOG_NONCACHED
	bool "Samsung Scheduler Logging on noncached buf"
	depends on SEC_DEBUG_SCHED_LOG
	default n
	help
	  This option enables sec_debug_sched_log_noncached support.
	  It can support non-cached sched log in RAM dump and We don't
	  need to concern cache flush status for analyzing sudden
	  lockup issue.

config SEC_DEBUG_TIMER_LOG
	bool "Samsung Timer Logging Feature"
	default n
	help
	  Samsung Timer Logging Feature for Debug use.

config SEC_DEBUG_SEMAPHORE_LOG
	bool "Samsung Semaphore Logging Feature"
	default n
	help
	  Samsung Semaphore Logging Feature for Debug use.

config SEC_DEBUG_USER
	bool "Panic on Userspace fault"
	default y
	help
	  Panic on Userspace fault

config SEC_DEBUG_PM_TEMP
	bool "Temporary Logging for Sleep/Wakeup Issue"
	default n
	help
	  Verbose Log on Sleep/Wakeup.

config SEC_DEBUG_IRQ_EXIT_LOG
	bool "Temporary Logging for IRQ delay"
	default n
	help
	  Verbose Logging for IRQ delay.

config SEC_DEBUG_AUXILIARY_LOG
	bool "Samsung Auxiliary Logging on noncached buf"
	default n
	help
	  This option enables sec_auxiliary_log support.
	  we can log repeated information insuitable for kernel log like DVFS
	  or power domain control information.
	  It can support non-cached auxiliary log in RAM dump and We don't
	  need to concern cache flush status for analyzing sudden
	  system hang issue.

config SEC_DEBUG_FUPLOAD_DUMP_MORE
	bool "Dump more information at forced upload"
	default n
	help
	  More information is printed out when a forced upload happens.
	  It uses customized dump functions instead of panic call.

config SEC_DEBUG_UNHANDLED_FAULT_SAFE
	bool "No extra dump around registers on unhandled fault"
	default n
	help
	  Preventing unhandled fault occur infinitely.
	  Some unhandled fault(eg. external abort) can cause a fault again
	  while accessing memory address of registers.

config SEC_DEBUG_CHECK_TASKPTR_FAULT
	bool "Pre-check task pointer is valid in page fault"
	default n
	help
	  Preventing stack overflow caused by invalid current task pointer.

config SEC_DEBUG_UMP_ALLOC_FAIL
	bool "Show warning message when UMP allcation fails"
	default n
	help
	  When UMP allocation fails there's no way to figure out the reason.
	  For UMP and Mali is supposed to allocate per 1 page,
	  we should take a good look at this failure.
	  This only shows the alloc fail warning.

config SEC_DEBUG_LIST_PANIC
	bool "Panic when list corruption detected"
	default n
	help
	  Panic when list structure corruption detected.
	  Sometimes list corruptions are reported.
	  But it reports only with WARN level.
	  This will immediately stop the system.

config SEC_DEBUG_IOVMM
	bool "panic when iovmm alloc fails"
	default n
	help 
	  panic when iovmm allocation fails
	  this will immediately stop the system.

config SEC_FILE_LEAK_DEBUG
	bool "Panic when file leak detected"
	default n
	help
	  Panic when file leak detected.

config SEC_DEBUG_TIMERQUEUE_CORRUPTION
	bool "Panic when timerqueue corruption detected"
	default n
	help
	  Panic when timerqueue corruption detected.

menuconfig SEC_WATCHDOG_RESET
	bool "exynos5410 watchdog reset to exit from lockup"
	depends on SOC_EXYNOS5410
	default n
	help
	  Use watchdog reset to exit from lockup

if SEC_WATCHDOG_RESET
config SEC_WATCHDOG_PET_TIME
	int "sec watchdog kicking time interval value"
	default 5
endif

endif

config SEC_LOG
	default n
	bool "Enable support for sec_log" if EMBEDDED
	depends on PRINTK && SEC_EXT
	help
	  This option enables sec_log support. This provides combined
	  log buffer for both bootloader and kernel. It also preserves
	  previous content before reboot.

config SEC_LOG_NONCACHED
	default n
	bool "Enable non cached kernel sec_log support" if EMBEDDED
	depends on SEC_LOG
	help
	  This option enables sec_non_cached_klog support.  It can
	  support non-cached kernel log in RAM dump and We don't need
	  to concern cache flush status for analyzing sudden lockup
	  issue.

config SEC_LOG_LAST_KMSG
	default n
	bool "Enable /proc/last_kmsg support" if EMBEDDED
	depends on SEC_LOG
	help
	  This option enables /proc/last_kmsg support.

config SEC_AVC_LOG
	default n
	bool "Enable avc audit log support" if EMBEDDED
	depends on SEC_DEBUG
	help
	  This option enables additional log buffer for audit log.

config SEC_DEBUG_TSP_LOG
	default n
	bool "Enable tsp log support" if EMBEDDED
	depends on SEC_DEBUG
	help
	  This option enables additional log buffer for tsp log.

config SEC_DEBUG_TIMA_LOG
	default y
	bool "Enable tima log support" if EMBEDDED
	depends on SEC_DEBUG && TIMA
	help
	  This option enables additional log buffer for tima log.

config SEC_DEBUG_PMU_LOG
	default n
	bool "Enable pmu log support" if EMBEDDED
	help
	  Samsung PMU Loging Feature for debugging use.

config SEC_DEBUG_CMU_LOG
	default n
	bool "Enable cmu log support" if EMBEDDED
	help
	  Samsung CMU Loging Feature for debugging use.

config SEC_DEBUG_SUBSYS
	default n
	bool "Enable summary dump support" if EMBEDDED
	help
	  Samsung Summary dump Feature for debugging use.

choice
	prompt "Forced panic type"
	default SEC_DEBUG_ISR_CRASH

	config SEC_DEBUG_ISR_CRASH
		bool "Call panic() in ISR context"
		help
		  Call panic() in ISR context when forced crash keys are pressed.

	config SEC_DEBUG_INPUT_HANDLER_CRASH
		bool "Call panic() through input handler function"
		help
		  Call panic() through input handler function when forced crash keys are pressed.
endchoice

comment "Samsung TN Power Management Options"
menuconfig SEC_PM
	bool "Samsung TN Power Management"
	default y
	help
	  Samsung TN Power Management.

config SEC_PM_DEBUG
	bool "Enable Samsung TN Power management debug support"
	default y
	depends on SEC_PM
	help
	  Enable Samsung TN Power management debug support.
```

## drivers/tspdrv/Kconfig
```kconfig
menuconfig VIBRATOR
	tristate "Vibrator"
	default y
	help
	  Say Y to enable Vibrator support.

if VIBRATOR
menu "TouchSense driver support"

config TSPDRV
	tristate "TouchSense driver support"
	default y

endmenu
endif
```

## drivers/video/exynos/Kconfig
```kconfig
#
# Exynos Video configuration
#

menuconfig EXYNOS_VIDEO
	bool "Exynos Video driver support"
	help
	  This enables support for EXYNOS Video device.

if EXYNOS_VIDEO

#
# MIPI DSI driver
#

config EXYNOS_MIPI_DSI
	bool "EXYNOS MIPI DSI driver support."
	depends on ARCH_S5PV210 || ARCH_EXYNOS
	help
	  This enables support for MIPI-DSI device.

config EXYNOS_LCD_S6E8AX0
	bool "S6E8AX0 MIPI AMOLED LCD Driver"
	depends on (EXYNOS_MIPI_DSI && BACKLIGHT_CLASS_DEVICE && LCD_CLASS_DEVICE)
	default n
	help
	  If you have an S6E8AX0 MIPI AMOLED LCD Panel, say Y to enable its
	  LCD control driver.

config EXYNOS_DP
	bool "EXYNOS DP driver support"
	depends on ARCH_EXYNOS
	default n
	help
	  This enables support for DP device.
	  
config EXYNOS_DUAL_MIPI_DISPLAY
	bool "EXYNOS Dual MIPI LCD display support"
	depends on EXYNOS_MIPI_DSI
	default n
	help
	  This enables support dual MIPI LCD display.

source "drivers/video/exynos/decon_display/Kconfig"
source "drivers/video/exynos/decon_tv_display/Kconfig"
source "drivers/video/exynos/decon/Kconfig"
if SOC_EXYNOS7580
source "drivers/video/exynos/decon_7580/Kconfig"
endif # SOC_EXYNOS7580

endif # EXYNOS_VIDEO
```
