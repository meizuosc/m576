## drivers/video/exynos/decon/Kconfig
```kconfig
config EXYNOS_DECON
	bool "Samsung Exynos Display system (VPP, DECON, MIPI, HDMI)"
	depends on FB

if EXYNOS_DECON
config USE_VSYNC_SKIP
	bool "Vsync Skip Enable"
	depends on EXYNOS_DECON
	default n
	help
	  Say Y here if you want to enable vsync skip feature for DFS solution.

config EXYNOS_DECON_FB
	bool "Samsung DECON Framebuffer driver"
	depends on EXYNOS_DECON
	select MEDIA_EXYNOS
	default y
	help
	  Say Y here if you want support for the DECON in Samsung S5P SoCs.
	  This device produce image data to one of output interfaces.

config EXYNOS_DECON_DPU
	bool "Samsung DPU driver"
	depends on EXYNOS_DECON_FB
	default n
	help
	  Say Y here if you want to support for DPU in Samsung SoCs.

config VIDEO_EXYNOS_HDMI
	bool "Samsung HDMI driver"
	depends on EXYNOS_DECON
	depends on !SOC_EXYNOS7580
	depends on VIDEO_V4L2
	select SWITCH
	select FB_MODE_HELPERS
	default y
	help
	  Say Y here if you want support for the HDMI output
	  interface in S5P Samsung SoC. The driver can be compiled
	  as module. It is an auxiliary driver, that exposes a V4L2
	  subdev for use by other drivers. This driver requires
	  hdmiphy driver to work correctly.

config VIDEO_EXYNOS_HDMI_AUDIO_I2S
	bool "Enable HDMI audio using I2S path"
	depends on EXYNOS_DECON
	depends on VIDEO_EXYNOS_HDMI
	depends on SND_SAMSUNG_I2S
	default y
	help
	  Enables HDMI audio through I2S path.

config VIDEO_EXYNOS_HDMI_CEC
	tristate "Samsung HDMI CEC Driver"
	depends on EXYNOS_DECON
	depends on VIDEO_EXYNOS_HDMI
	depends on VIDEO_DEV && VIDEO_V4L2 && I2C
	default n
	help
	  Say Y here if you want support for the HDMI CEC
	  interface in S5P Samsung SoC. The driver can be compiled
	  as module.

config EXYNOS_MIPI_DSI
	bool "Samsung Exynos MIPI-DSI driver"
	depends on EXYNOS_DECON
	default y
	help
	  Enable MIPI-DSI driver.

config DECON_MIPI_DSI_PKTGO
	bool "Samsung Exynos MIPI-DSI Packet Go"
	depends on EXYNOS_MIPI_DSI
	default n
	help
	  Enable/disable MIPI-DSI Packet Go function

config DECON_LPD_DISPLAY
        bool "Decon Low Power Display MODE"
        depends on EXYNOS_DECON
        default y

config FB_WINDOW_UPDATE
        bool "DECON window update mode"
        depends on EXYNOS_DECON
        default n

config DECON_BLOCKING_MODE
	bool "DECON blocking mode"
        depends on EXYNOS_DECON
        default y

config DECON_EVENT_LOG
	bool "Display sub-system event logger (DECON/DSIM/VPP)"
        depends on DEBUG_INFO && EXYNOS_DECON
        default y

config DECON_DISPLAY_LOGO
	bool "Display kernel logo"
	depends on EXYNOS_DECON
	default n

config DECON_SIMULATE_DISPLAY
	bool "Decon simulate display"
	depends on EXYNOS_DECON
	default n

source "drivers/video/exynos/decon/vpp/Kconfig"

endif

source "drivers/video/exynos/decon/panels/Kconfig"
```

## drivers/video/exynos/decon/panels/Kconfig
```kconfig
config EXYNOS_DECON_LCD
	depends on EXYNOS_DECON
	bool "Select LCD panel driver"
	
config EXYNOS_DECON_LCD_S6E3FA0
	depends on EXYNOS_DECON_LCD && EXYNOS_MIPI_DSI
	#select FB_WINDOW_UPDATE
	tristate "S6E3FA0 AMOLED FHD LCD driver(1080 x 1920)"

config EXYNOS_DECON_LCD_S6E8AA0
	depends on EXYNOS_DECON_LCD && EXYNOS_MIPI_DSI
	tristate "S6E8AA0 AMOLED HD LCD driver(720 x 1280)"

config EXYNOS_DECON_LCD_S6E8FA0
	depends on EXYNOS_DECON_LCD && EXYNOS_MIPI_DSI
	tristate "S6E8FA0 AMOLED FHD LCD driver(1080 x 1920)"

config MEIZU_DECON_LCD_S6E3FA3
	depends on EXYNOS_DECON_LCD && EXYNOS_MIPI_DSI
	tristate "MEIZU S6E3FA3 AMOLED FHD LCD driver(1080 x 1920)"
```

## drivers/video/exynos/decon/vpp/Kconfig
```kconfig
config EXYNOS_VPP
	bool "Samsung Exynos Video Post Processor driver"
	depends on EXYNOS_DECON
	depends on !SOC_EXYNOS7580
	default y
	help
	  Enable VPP driver.
```

## drivers/video/exynos/decon_7580/Kconfig
```kconfig
config EXYNOS_DECON_EXYNOS7580
	bool "Samsung Exynos Display system (DECON, MIPI)"
	depends on FB

if EXYNOS_DECON_EXYNOS7580
config EXYNOS_DECON_FB
	bool "Samsung DECON Framebuffer driver"
	depends on EXYNOS_DECON_EXYNOS7580
	select MEDIA_EXYNOS
	default y
	help
	  Say Y here if you want support for the DECON in Samsung S5P SoCs.
	  This device produce image data to one of output interfaces.

config EXYNOS_MIPI_DSI
	bool "Samsung Exynos MIPI-DSI driver"
	depends on EXYNOS_DECON_EXYNOS7580
	default y
	help
	  Enable MIPI-DSI driver.

config DECON_MIPI_DSI_PKTGO
	bool "Samsung Exynos MIPI-DSI Packet Go"
	depends on EXYNOS_DECON_EXYNOS7580 && EXYNOS_MIPI_DSI
	default n
	help
	  Enable/disable MIPI-DSI Packet Go function

config DECON_LPD_DISPLAY
        bool "Decon Low Power Display MODE"
        depends on EXYNOS_DECON_EXYNOS7580
        default y

config CONFIG_DECON_LPD_DISPLAY_WITH_CAMERA
        bool "Decon Low Power Display MODE with Camera"
        depends on DECON_LPD_DISPLAY

config DECON_PM_QOS_REQUESTS
	bool "Decon PM QoS requests to DVFS drivers"
	depends on EXYNOS_DECON_EXYNOS7580
	default y

config FB_WINDOW_UPDATE
        bool "DECON window update mode"
        depends on EXYNOS_DECON_EXYNOS7580
        default n

config DECON_BLOCKING_MODE
	bool "DECON blocking mode"
        depends on EXYNOS_DECON_EXYNOS7580
        default y

source "drivers/video/exynos/decon_7580/panels/Kconfig"

endif
```

## drivers/video/exynos/decon_7580/panels/Kconfig
```kconfig
config EXYNOS_DECON_DISP_LCD
	depends on EXYNOS_DECON_EXYNOS7580
	bool "Select LCD panel driver"

config EXYNOS_DECON_LCD_S6E3FA0
	depends on EXYNOS_DECON_DISP_LCD && EXYNOS_MIPI_DSI
	tristate "S6E3FA0 AMOLED FHD LCD driver(1080 x 1920)"
```

## drivers/video/exynos/decon_display/Kconfig
```kconfig
menuconfig EXYNOS_DECON_DISPLAY
	bool "Samsung Display Enhancement Controller(DECON)"
	select FB_CFB_FILLRECT
	select FB_CFB_COPYAREA
	select FB_CFB_IMAGEBLIT
	select S5P_DEV_MIPI_DSIM0
	depends on FB

if EXYNOS_DECON_DISPLAY
config EXYNOS_DECON_DISPLAY_FB
	bool "Samsung DECON Framebuffer driver"
	depends on EXYNOS_DECON_DISPLAY
	default y

config DECON_MIC
	bool "Samsung MIC driver"
	depends on EXYNOS_DECON_DISPLAY_FB
	default n

config DECON_MIPI_DSI
	bool "Samsung DECON MIPI-DSI driver"
	depends on EXYNOS_DECON_DISPLAY_FB
	default n

config DECON_MIPI_DSI_PKTGO
	bool "Samsung DECON MIPI-DSI Packet Go"
	depends on DECON_MIPI_DSI
	default n

config FB_EXYNOS_FIMD_MC
	bool "DECON/FIMD MEDIA CONTROLLER Support"
	depends on EXYNOS_DECON_DISPLAY
	depends on MEDIA_CONTROLLER
	default y

config FB_I80_COMMAND_MODE
	bool "DECON FB I80 MODE"
	depends on EXYNOS_DECON_DISPLAY_FB
	default n

config FB_I80_HW_TRIGGER
	bool "I80 Hardware Trigger Mode"
	depends on FB_I80_COMMAND_MODE
	default y

config FB_I80_SW_TRIGGER
	bool "I80 Software Trigger Mode"
	depends on FB_I80_COMMAND_MODE
	default n

config FB_WINDOW_UPDATE
	bool "DECON window update mode"
	depends on FB_I80_COMMAND_MODE && EXYNOS_DECON_DISPLAY
	default n

config FB_HIBERNATION_DISPLAY
	bool "FB Hibernation Display MODE"
	depends on FB_I80_COMMAND_MODE
	default n

config FB_HIBERNATION_DISPLAY_CLOCK_GATING
	bool "Support clock-gating"
	depends on FB_HIBERNATION_DISPLAY
	default y

config FB_HIBERNATION_DISPLAY_POWER_GATING
	bool "Support power-gating"
	depends on FB_HIBERNATION_DISPLAY_CLOCK_GATING
	default n

config FB_HIBERNATION_DISPLAY_POWER_GATING_DEEPSTOP
	bool "Support power-gating with deep-stop"
	depends on FB_HIBERNATION_DISPLAY_POWER_GATING
	default n

source "drivers/video/exynos/panels/Kconfig"

config S5P_DEV_MIPI_DSIM0
	bool
endif
```

## drivers/video/exynos/panels/Kconfig
```kconfig
config DECON_LCD
	depends on EXYNOS_DECON_DISPLAY
	bool "Select LCD panel driver"

config DECON_LCD_S6E8AA0
	depends on DECON_LCD && DECON_MIPI_DSI
	tristate "S6E8AA0 AMOLED HD LCD driver(800 x 1280)"

config DECON_LCD_S6E3FA0
	depends on DECON_LCD && DECON_MIPI_DSI
	tristate "S6E3FA0 AMOLED FULL HD LCD driver(1080 x 1920)"
```

## sound/soc/codecs/dbmd2/Kconfig
```kconfig
#
# SoC audio configuration
#

config SND_DSPG_DBMD2
	bool "Dspg Voice Trigger dbd2"
	default n
	help
	  This is DSPG Voice trigger Authentication Device.
	  The chip version is dbd2.
```

## sound/soc/meizu/Kconfig
```kconfig
config SND_SOC_WM8998_CODEC_MASTER
	tristate

config SND_SOC_MEIZU_AUDIO
	tristate "Meizu Audio Driver: Exynos5430 + WM8998 + ES705 + ESS9018K2M"
	depends on SND_SOC_SAMSUNG
	default y
	select SND_SAMSUNG_I2S
	select SND_SAMSUNG_AUDSS
	select SND_SAMSUNG_IOMMU
	select SND_SOC_WM8998
	select SND_SOC_ESS9018K2M
	select SND_SOC_ES705_ESCORE
	select SND_SOC_ES_SPI
	select SND_SOC_ES_HIGH_BW_BUS_SPI
	select SND_SOC_ES_RUNTIME_SUSPEND_MODE_CVQ
	select SND_SOC_ES_CDEV
	select SND_SOC_ES_SPI_STREAMDEV
	select SND_SOC_ES_VS
	select SND_SOC_ES_WAKEUP_GPIO
	select MFD_ARIZONA
	select MFD_ARIZONA_I2C
	select MFD_WM8998
	select REGULATOR_ARIZONA
	select SWITCH_ARIZONA
	select SND_SOC_WM8998_CODEC_MASTER
	help
		say y if you want to add support for soc audio on the meizu.

config SND_SOC_DUMMY_AUDIO
	tristate "Dummy Audio Driver: a dummy sound card for debug"
	default n
	select SND_SAMSUNG_AUDSS
	select SND_SAMSUNG_IOMMU
	select SND_SOC_DUMMY_CODEC
	help
		say y if you want to add support for soc dummy audio.

# source "sound/soc/meizu/audience/Kconfig"
```
